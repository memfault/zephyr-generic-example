## CMakeLists.txt
```
#-------------------------------------------------------------------------------
# Zephyr Example Application
#
# Copyright (c) 2021 Nordic Semiconductor ASA
# SPDX-License-Identifier: Apache-2.0

cmake_minimum_required(VERSION 3.13.1)
find_package(Zephyr REQUIRED HINTS $ENV{ZEPHYR_BASE})

project(app LANGUAGES C VERSION 1.0.0)

target_sources(app PRIVATE src/main.c)

zephyr_include_directories(config)
```

## prj.conf
```kconfig
# This file contains selected Kconfig options for the application.

# Memfault configuration
CONFIG_MEMFAULT=y

# Disable trusted execution for simplicity
CONFIG_TRUSTED_EXECUTION_SECURE=n
CONFIG_TRUSTED_EXECUTION_NONSECURE=y

# Enable UART console and shell for testing memfault
CONFIG_CONSOLE=y
CONFIG_UART_CONSOLE=y
CONFIG_SHELL=y

CONFIG_LOG=y
# LOG v2 option, only for pre zephyr-v3.1.0
# CONFIG_LOG2_MODE_DEFERRED=y
CONFIG_LOG_BACKEND_UART=y
# Disable shell log output to prevent duplicate logs, since UART backend is
# already enabled. Shell log backend enables later than UART backend, and won't
# show the boot splash messages, so it's simpler to just enable the UART
# backend. Note that the RTT backend is enabled by default- that's ok, and could
# be useful if the board doesn't have a UART available.
CONFIG_SHELL_LOG_BACKEND=n

# These stats would be used for tracking system heap (k_malloc() etc.)
# CONFIG_SYS_HEAP_RUNTIME_STATS=y

# The minimal libc does not have built-in stats, but if used, it needs arena
# size > 0
# CONFIG_MINIMAL_LIBC_MALLOC_ARENA_SIZE=1024

# Use newlib libc, which provides mallinfo() for heap stats
CONFIG_NEWLIB_LIBC=y
```

## src/main.c
```c
#include <device.h>
#include <devicetree.h>
#include <drivers/gpio.h>
#include <logging/log.h>
#include <zephyr.h>

#include "memfault/components.h"

LOG_MODULE_REGISTER(main, LOG_LEVEL_INF);

// Blink code taken from the zephyr/samples/basic/blinky example.
static void blink_forever(void) {
#if CONFIG_QEMU_TARGET
  k_sleep(K_FOREVER);
#else
/* 1000 msec = 1 sec */
#define SLEEP_TIME_MS 1000

/* The devicetree node identifier for the "led0" alias. */
#define LED0_NODE DT_ALIAS(led0)

  static const struct gpio_dt_spec led = GPIO_DT_SPEC_GET(LED0_NODE, gpios);

  int ret = gpio_pin_configure_dt(&led, GPIO_OUTPUT_ACTIVE);
  if (ret < 0) {
    return;
  }

  while (1) {
    gpio_pin_toggle_dt(&led);
    k_msleep(SLEEP_TIME_MS);
  }
#endif  // CONFIG_QEMU_TARGET
}

void memfault_platform_get_device_info(sMemfaultDeviceInfo *info) {
  *info = (sMemfaultDeviceInfo){
      .device_serial = "DEMOSERIAL",
      .software_type = "zephyr-app",
      .software_version = "1.0.0+" ZEPHYR_MEMFAULT_EXAMPLE_GIT_SHA1,
      .hardware_version = CONFIG_BOARD,
  };
}

#if CONFIG_ZEPHYR_MEMFAULT_EXAMPLE_THREAD_TOGGLE
K_THREAD_STACK_DEFINE(test_thread_stack_area, 1024);
static struct k_thread test_thread;

static void prv_test_thread_function(void *arg0, void *arg1, void *arg2) {
  ARG_UNUSED(arg0);
  ARG_UNUSED(arg1);
  ARG_UNUSED(arg2);

  k_sleep(K_FOREVER);
}

static void prv_test_thread_work_handler(struct k_work *work) {
  ARG_UNUSED(work);

  static bool started = false;
  if (started) {
    LOG_INF("ending test_thread ❌");
    k_thread_abort(&test_thread);
    started = false;
  } else {
    LOG_INF("starting test_thread ✅");
    k_thread_create(&test_thread, test_thread_stack_area,
                    K_THREAD_STACK_SIZEOF(test_thread_stack_area),
                    prv_test_thread_function, NULL, NULL, NULL, 7, 0,
                    K_FOREVER);
    k_thread_name_set(&test_thread, "test_thread");
    k_thread_start(&test_thread);
    started = true;
  }
}
K_WORK_DEFINE(s_test_thread_work, prv_test_thread_work_handler);

//! Timer handlers run from an ISR so we dispatch the heartbeat job to the
//! worker task
static void prv_test_thread_timer_expiry_handler(struct k_timer *dummy) {
  k_work_submit(&s_test_thread_work);
}
K_TIMER_DEFINE(s_test_thread_timer, prv_test_thread_timer_expiry_handler, NULL);

static void prv_init_test_thread_timer(void) {
  k_timer_start(&s_test_thread_timer, K_SECONDS(10), K_SECONDS(10));

  // fire one time right away
  k_work_submit(&s_test_thread_work);
}
#else
static void prv_init_test_thread_timer(void) {}
#endif  // CONFIG_ZEPHYR_MEMFAULT_EXAMPLE_THREAD_TOGGLE

void main(void) {
  LOG_INF("👋 Memfault Demo App! Board %s\n", CONFIG_BOARD);
  memfault_device_info_dump();

  prv_init_test_thread_timer();

  blink_forever();
}
```

## src/internal_flash_coredump_storage.c
```c
#include <zephyr.h>

// #include <sys/util.h>

#include <stdlib.h>
// #include <string.h>
#include <drivers/flash.h>
#include <logging/log.h>
#include <soc.h>

#include "memfault/components.h"
#include "memfault/ports/buffered_coredump_storage.h"

LOG_MODULE_REGISTER(mflt_coredump_storage, LOG_LEVEL_INF);

#ifdef DT_CHOSEN_ZEPHYR_FLASH_CONTROLLER_LABEL
#define FLASH_DEV_NAME DT_CHOSEN_ZEPHYR_FLASH_CONTROLLER_LABEL
#else
#error "must have a flash contoller"
#endif

// On the STM32WL55, 256kB of flash from 0x0800_0000 to 0x0803_FFFF
#define FLASH_START_ADDR 0x08000000
#define MEMFAULT_COREDUMP_STORAGE_START_ADDR (0x08030000 - FLASH_START_ADDR)
#define MEMFAULT_COREDUMP_STORAGE_END_ADDR (0x08040000 - FLASH_START_ADDR)

// void memfault_platform_fault_handler(const sMfltRegState *regs,
//                                      eMemfaultRebootReason reason) {
//   memfault_stm32cubewb_flash_clear_ecc_errors(
//       MEMFAULT_COREDUMP_STORAGE_START_ADDR,
//       MEMFAULT_COREDUMP_STORAGE_END_ADDR, NULL);
// }

// Error writing to flash - should never happen & likely detects a
// configuration error. Call the reboot handler which will halt the device if
// a debugger is attached and then reboot.
// MEMFAULT_NO_OPT
// static void prv_coredump_writer_assert_and_reboot(int error_code) {
//   LOG_ERR("Error writing to flash, error_code: %d", error_code);
//   memfault_platform_halt_if_debugging();
//   memfault_platform_reboot();
// }

static bool prv_op_within_storage_bounds(uint32_t offset, size_t data_len) {
  sMfltCoredumpStorageInfo info = {0};
  memfault_platform_coredump_storage_get_info(&info);
  return (offset + data_len) <= info.size;
}

void memfault_platform_coredump_storage_clear(void) {
  int result = memfault_platform_coredump_storage_erase(
      MEMFAULT_COREDUMP_STORAGE_START_ADDR, 4);
  if (result != 0) {
    MEMFAULT_LOG_ERROR("Could not clear coredump storage %d", result);
  }
}

void memfault_platform_coredump_storage_get_info(
    sMfltCoredumpStorageInfo *info) {
  const size_t size =
      MEMFAULT_COREDUMP_STORAGE_END_ADDR - MEMFAULT_COREDUMP_STORAGE_START_ADDR;

  *info = (sMfltCoredumpStorageInfo){
      .size = size,
      .sector_size = 2048,  // hard coded, not used anywhere anyway
  };
}

bool memfault_platform_coredump_storage_buffered_write(
    sCoredumpWorkingBuffer *blk) {
  const uint32_t start_addr = MEMFAULT_COREDUMP_STORAGE_START_ADDR;
  const uint32_t addr = start_addr + blk->write_offset;

  uint64_t data;
  const struct device *flash_dev = device_get_binding(FLASH_DEV_NAME);

  for (size_t i = 0; i < MEMFAULT_COREDUMP_STORAGE_WRITE_SIZE;
       i += sizeof(data)) {
    memcpy(&data, &blk->data[i], sizeof(data));

    if (flash_write(flash_dev, addr + i, &data, sizeof(data)) != 0) {
      LOG_ERR("write error");
      // prv_coredump_writer_assert_and_reboot(res);
      return false;
    }

    uint64_t check_data = 0;
    (void)flash_read(flash_dev, addr + i, &check_data, sizeof(check_data));
    if (check_data != data) {
      LOG_ERR("readback error");
      // prv_coredump_writer_assert_and_reboot(res);
      return false;
    }
  }

  *blk = (sCoredumpWorkingBuffer){0};
  return true;
}

bool memfault_platform_coredump_storage_read(uint32_t offset, void *data,
                                             size_t read_len) {
  if (!prv_op_within_storage_bounds(offset, read_len)) {
    return false;
  }

  // The internal flash is memory mapped so we can just use memcpy!
  const uint32_t start_addr = MEMFAULT_COREDUMP_STORAGE_START_ADDR;
  memcpy(data, (void *)(start_addr + offset), read_len);
  return true;
}

bool memfault_platform_coredump_storage_erase(uint32_t offset,
                                              size_t erase_size) {
  const struct device *flash_dev = device_get_binding(FLASH_DEV_NAME);
  struct flash_pages_info info;

  // get starting offset
  int result = flash_get_page_info_by_offs(flash_dev, offset, &info);
  if (result != 0) {
    LOG_ERR("Could not get flash page info for offset 0x%x", offset);
    return false;
  }

  // get ending offset
  size_t start_offset = info.start_offset;
  offset = offset + erase_size;
  result = flash_get_page_info_by_offs(flash_dev, offset, &info);
  if (result != 0) {
    LOG_ERR("Could not get flash page info for offset 0x%x", offset);
    return false;
  }

  // total erase size
  size_t size = info.start_offset + info.size;

  // perform the erase
  LOG_INF("erasing flash pages 0x%x-0x%x", start_offset, start_offset + size);

  result = flash_erase(flash_dev, start_offset, size);

  if (result != 0) {
    LOG_ERR("Could not erase flash pages 0x%x-0x%x", start_offset,
            start_offset + size);
    return false;
  }

  return true;
}
```

## src/memfault_platform_config.h
```c
#define MEMFAULT_COREDUMP_COLLECT_HEAP_STATS 1
```

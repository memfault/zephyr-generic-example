## west.yml
```yaml
# West manifest for Memfault Example Application

manifest:
  self:
    path: zephyr-memfault-example

  remotes:
    - name: zephyrproject-rtos
      url-base: https://github.com/zephyrproject-rtos
    - name: memfault
      url-base: https://github.com/memfault

  projects:
    - name: zephyr
      remote: zephyrproject-rtos
      revision: zephyr-v2.7.0
      import: true

    # The Memfault SDK
    - name: memfault-firmware-sdk
      path: modules/lib/memfault-firmware-sdk
      revision: rt102x-noinit-workaround
      remote: memfault
```
